## board/olimex/sam9_l9260/Kconfig
```kconfig
if TARGET_OLIMEX_SAM9_L9260

config SYS_BOARD
	default "sam9_l9260"

config SYS_VENDOR
	default "olimex"

config SYS_CONFIG_NAME
	default "sam9_l9260"

config SPL_SPI_SAM9_L9260
	bool "Support loading u-boot from DataFlash in SPL"
endif
```

## configs/A20-OLinuXino_defconfig
```kconfig
CONFIG_ARM=y
CONFIG_ARCH_SUNXI=y
CONFIG_SPL=y
CONFIG_MACH_SUN7I=y
CONFIG_DRAM_CLK=384
CONFIG_DEFAULT_DEVICE_TREE="sun7i-a20-olinuxino"
CONFIG_AHCI=y
# CONFIG_SYS_MALLOC_CLEAR_ON_INIT is not set
CONFIG_SPL_I2C_SUPPORT=y
CONFIG_CMD_DFU=y
# CONFIG_CMD_FLASH is not set
CONFIG_CMD_USB_MASS_STORAGE=y
# CONFIG_SPL_DOS_PARTITION is not set
# CONFIG_SPL_PARTITION_UUIDS is not set
CONFIG_SPL_BOARD_INIT=y
# SPL_NAND_SUPPORT is not set
CONFIG_BOOTDELAY=1

CONFIG_CMD_SF=y
CONFIG_CMD_SF_TEST=y

CONFIG_DM_SPI_FLASH=y
CONFIG_SPI_FLASH=y
CONFIG_SPI_FLASH_WINBOND=y
CONFIG_SPL_SPI_SUNXI=y

CONFIG_SPI=y
CONFIG_DM_SPI=y
CONFIG_SUN4I_SPI=y
CONFIG_SPI_FLASH_MTD=y

# CONFIG_ENV_IS_IN_FAT is not set
CONFIG_ENV_IS_IN_EXT4=y
CONFIG_ENV_EXT4_INTERFACE="mmc"
CONFIG_ENV_EXT4_DEVICE_AND_PART="0:auto"
CONFIG_ENV_EXT4_FILE="/boot/uboot.env"
CONFIG_ENV_IS_IN_SPI_FLASH=y
CONFIG_ENV_OFFSET=0x200000
CONFIG_ENV_SIZE=0x20000

CONFIG_MTD=y
CONFIG_NAND=y
CONFIG_NAND_SUNXI_SPL_ECC_STRENGTH=40
CONFIG_NAND_SUNXI_SPL_ECC_SIZE=1024
CONFIG_NAND_SUNXI_SPL_USABLE_PAGE_SIZE=8192

CONFIG_SYS_NAND_BLOCK_SIZE=0x200000
CONFIG_SYS_NAND_PAGE_SIZE=0x2000
CONFIG_SYS_NAND_OOBSIZE=0x280

CONFIG_CMD_MTDPARTS=y
CONFIG_MTDIDS_DEFAULT="nand0=nand.0,nor0=nor.0"
CONFIG_MTDPARTS_DEFAULT="mtdparts=nand.0:4m(NAND.SPL),4m(NAND.SPL.backup),4m(NAND.u-boot),4m(NAND.u-boot.backup),4m(NAND.u-boot-env),4m(NAND.u-boot-env.backup),4m(NAND.dtb),16m(NAND.kernel),-(NAND.rootfs);nor.0:2m(SPI.u-boot),128k(SPI.u-boot-env),128k(SPI.u-boot-env.backup),-(SPI.user)"

CONFIG_DM_MMC=y
CONFIG_SCSI_AHCI=y

CONFIG_DFU_MMC=y
CONFIG_DFU_NAND=y
CONFIG_DFU_RAM=y
CONFIG_DFU_SF=y

CONFIG_FASTBOOT_CMD_OEM_FORMAT=y
# CONFIG_PHY_ADDR_ENABLE is not set
CONFIG_ETH_DESIGNWARE=y
CONFIG_RGMII=y
CONFIG_SUN7I_GMAC=y
CONFIG_PHY_SMSC=y
CONFIG_PHY_REALTEK=y
CONFIG_PHY_MICREL=y
CONFIG_PHY_MICREL_KSZ90X1=y
CONFIG_AXP_ALDO3_VOLT=2800
CONFIG_AXP_ALDO4_VOLT=2800
CONFIG_SCSI=y
CONFIG_USB_EHCI_HCD=y
CONFIG_USB_MUSB_GADGET=y
CONFIG_SYS_USB_EVENT_POLL_VIA_INT_QUEUE=y
CONFIG_TARGET_A20_OLINUXINO=y
CONFIG_OF_LIBFDT_OVERLAY=y
CONFIG_FIT=y
CONFIG_OF_BOARD_FIXUP=y
CONFIG_FDT_FIXUP_PARTITIONS=y
CONFIG_OF_SYSTEM_SETUP=y
CONFIG_OF_LIST="sun7i-a20-olinuxino-micro sun7i-a20-olinuxino-micro-emmc sun7i-a20-olinuxino-lime sun7i-a20-olinuxino-lime-emmc sun7i-a20-olinuxino-lime2 sun7i-a20-olinuxino-lime2-emmc sun7i-a20-olimex-som-evb sun7i-a20-olimex-som-evb-emmc sun7i-a20-olimex-som204-evb sun7i-a20-olimex-som204-evb-emmc"
CONFIG_MULTI_DTB_FIT=y

CONFIG_BOARD_EARLY_INIT_R=y

CONFIG_USB_GADGET_MANUFACTURER="Olimex Ltd."
CONFIG_USB_GADGET_VENDOR_NUM=0x15ba
CONFIG_USB_GADGET_PRODUCT_NUM=0x0041
# CONFIG_USB_ETHER is not set

CONFIG_VIDEO_LCD_PANEL_OLINUXINO=y
```

## configs/A33-OLinuXino_defconfig
```kconfig
CONFIG_ARM=y
CONFIG_ARCH_SUNXI=y
CONFIG_SPL=y
CONFIG_MACH_SUN8I_A33=y
CONFIG_TARGET_A33_OLINUXINO=y
CONFIG_DRAM_CLK=432
CONFIG_DRAM_ZQ=15291
CONFIG_DRAM_ODT_EN=y
CONFIG_AXP_GPIO=y
CONFIG_DEFAULT_DEVICE_TREE="sun8i-a33-olinuxino"
CONFIG_NR_DRAM_BANKS=1
# CONFIG_SYS_MALLOC_CLEAR_ON_INIT is not set
CONFIG_SPL_I2C_SUPPORT=y
CONFIG_CMD_DFU=y
# CONFIG_CMD_FLASH is not set
CONFIG_CMD_USB_MASS_STORAGE=y
# CONFIG_SPL_DOS_PARTITION is not set
# CONFIG_SPL_PARTITION_UUIDS is not set
CONFIG_BOOTDELAY=1

CONFIG_ENV_IS_IN_FAT=y
CONFIG_ENV_FAT_INTERFACE="mmc"
CONFIG_ENV_FAT_DEVICE_AND_PART="0:auto"
CONFIG_ENV_IS_IN_EXT4=y
CONFIG_ENV_EXT4_INTERFACE="mmc"
CONFIG_ENV_EXT4_DEVICE_AND_PART="0:auto"
CONFIG_ENV_EXT4_FILE="/boot/uboot.env"
CONFIG_ENV_OFFSET=0x200000
CONFIG_ENV_SIZE=0x20000

CONFIG_MTD=y
CONFIG_NAND=y
CONFIG_NAND_SUNXI_SPL_ECC_STRENGTH=40
CONFIG_NAND_SUNXI_SPL_ECC_SIZE=1024
CONFIG_NAND_SUNXI_SPL_USABLE_PAGE_SIZE=8192

CONFIG_SYS_NAND_BLOCK_SIZE=0x200000
CONFIG_SYS_NAND_PAGE_SIZE=0x2000
CONFIG_SYS_NAND_OOBSIZE=0x280

CONFIG_CMD_MTDPARTS=y
CONFIG_MTDIDS_DEFAULT="nand0=nand.0"
CONFIG_MTDPARTS_DEFAULT="mtdparts=nand.0:4m(NAND.SPL),4m(NAND.SPL.backup),4m(NAND.u-boot),4m(NAND.u-boot.backup),4m(NAND.u-boot-env),4m(NAND.u-boot-env.backup),4m(NAND.dtb),16m(NAND.kernel),-(NAND.rootfs)"

CONFIG_DFU_MMC=y
CONFIG_DFU_NAND=y
CONFIG_DFU_RAM=y

CONFIG_FASTBOOT_CMD_OEM_FORMAT=y
# CONFIG_PHY_ADDR_ENABLE is not set
# CONFIG_SPL_EFI_PARTITION is not set
CONFIG_AXP_DCDC1_VOLT=3300

CONFIG_USB_EHCI_HCD=y
CONFIG_USB_MUSB_GADGET=y
CONFIG_SYS_USB_EVENT_POLL_VIA_INT_QUEUE=y
CONFIG_OF_LIBFDT_OVERLAY=y
CONFIG_OF_SYSTEM_SETUP=y

CONFIG_BOARD_EARLY_INIT_R=y

CONFIG_USB_GADGET_MANUFACTURER="Olimex Ltd."
CONFIG_USB_GADGET_VENDOR_NUM=0x15ba
CONFIG_USB_GADGET_PRODUCT_NUM=0x041

CONFIG_VIDEO_LCD_PANEL_OLINUXINO=y
```

## configs/A64-OLinuXino_defconfig
```kconfig
CONFIG_ARM=y
CONFIG_ARCH_SUNXI=y
CONFIG_SPL=y
CONFIG_SPL_LOAD_FIT=y
CONFIG_MACH_SUN50I=y
CONFIG_TARGET_A64_OLINUXINO=y
CONFIG_RESERVE_ALLWINNER_BOOT0_HEADER=y
CONFIG_MMC_SUNXI_SLOT_EXTRA=2
CONFIG_NR_DRAM_BANKS=1
# CONFIG_SYS_MALLOC_CLEAR_ON_INIT is not set
# CONFIG_CMD_FLASH is not set
# CONFIG_SPL_DOS_PARTITION is not set
# CONFIG_SPL_EFI_PARTITION is not set
# CONFIG_EFI_LOADER is not set
CONFIG_SUN8I_EMAC=y
CONFIG_USB_EHCI_HCD=y
CONFIG_SYS_USB_EVENT_POLL_VIA_INT_QUEUE=y
CONFIG_USB_MUSB_GADGET=y
CONFIG_SPL_BOARD_INIT=y
CONFIG_DEFAULT_DEVICE_TREE="sun50i-a64-olinuxino-1G"
CONFIG_OF_LIST="sun50i-a64-olinuxino-1G sun50i-a64-olinuxino-1Ge4GW sun50i-a64-olinuxino-1Ge16GW sun50i-a64-olinuxino-1Gs16M sun50i-a64-olinuxino-2Ge8G"
CONFIG_MULTI_DTB_FIT=y
CONFIG_OF_BOARD_FIXUP=y

CONFIG_CMD_SF=y
CONFIG_CMD_SF_TEST=y

CONFIG_DM_SPI_FLASH=y
CONFIG_SPI_FLASH=y
CONFIG_SPI_FLASH_WINBOND=y
CONFIG_SPL_SPI_SUNXI=y



CONFIG_DM_REGULATOR_FIXED=y

CONFIG_SPI=y
CONFIG_DM_SPI=y
CONFIG_SPI_SUNXI=y
CONFIG_SPI_FLASH_MTD=y
CONFIG_FDT_FIXUP_PARTITIONS=y

# CONFIG_ENV_IS_IN_FAT is not set
CONFIG_ENV_IS_IN_EXT4=y
CONFIG_ENV_EXT4_INTERFACE="mmc"
CONFIG_ENV_EXT4_DEVICE_AND_PART="0:auto"
CONFIG_ENV_EXT4_FILE="/boot/uboot.env"
CONFIG_ENV_IS_IN_SPI_FLASH=y
CONFIG_ENV_OFFSET=0x200000
CONFIG_ENV_SIZE=0x20000

CONFIG_MTD=y
CONFIG_MTD_PARTITIONS=y
CONFIG_MTD_DEVICE=y


CONFIG_CMD_MTDPARTS=y
CONFIG_MTDIDS_DEFAULT="nor0=nor.0"
CONFIG_MTDPARTS_DEFAULT="mtdparts=nor.0:2m(SPI.u-boot),128k(SPI.u-boot-env),128k(SPI.u-boot-env.backup),-(SPI.user)"


CONFIG_DM_MMC=y
CONFIG_DM_SCSI=y
CONFIG_SCSI_AHCI=y

CONFIG_DFU_MMC=y
CONFIG_DFU_RAM=y
CONFIG_DFU_SF=y

CONFIG_CMD_DFU=y
CONFIG_CMD_USB_MASS_STORAGE=y

CONFIG_USB_GADGET_MANUFACTURER="Olimex Ltd."
CONFIG_USB_GADGET_VENDOR_NUM=0x15ba
CONFIG_USB_GADGET_PRODUCT_NUM=0x0041
# CONFIG_USB_ETHER is not set

CONFIG_VIDEO_LCD_OLINUXINO_PANEL=y
```

## configs/OLIMEX_SAM9_L9260_defconfig
```kconfig
CONFIG_ARM=y
CONFIG_ARCH_AT91=y
CONFIG_SYS_TEXT_BASE=0x21f00000
CONFIG_TARGET_OLIMEX_SAM9_L9260=y
CONFIG_SYS_MALLOC_F_LEN=0x2000
CONFIG_NR_DRAM_BANKS=1
CONFIG_FIT=y
CONFIG_SYS_EXTRA_OPTIONS="AT91SAM9260"
CONFIG_BOOTDELAY=3
# CONFIG_DISPLAY_BOARDINFO is not set
CONFIG_BOARD_EARLY_INIT_F=y
CONFIG_HUSH_PARSER=y
# CONFIG_CMD_IMI is not set
CONFIG_CMD_DFU=y
# CONFIG_CMD_LOADS is not set
CONFIG_CMD_NAND=y
CONFIG_CMD_USB=y
# CONFIG_CMD_SOURCE is not set
CONFIG_CMD_DHCP=y
CONFIG_CMD_PING=y
CONFIG_CMD_FAT=y
CONFIG_CMD_MTDPARTS=y
CONFIG_MTDIDS_DEFAULT="nand0=nand.0"
CONFIG_MTDPARTS_DEFAULT="mtdparts=nand.0:128k(NAND.fdt),8m(NAND.kernel),-(NAND.rootfs)"
# CONFIG_DOS_PARTITION is not set
CONFIG_OF_CONTROL=y
CONFIG_OF_EMBED=y
CONFIG_DEFAULT_DEVICE_TREE="at91sam9260-olimex"
CONFIG_ENV_IS_IN_SPI_FLASH=y
CONFIG_CLK=y
CONFIG_CLK_AT91=y
# CONFIG_MMC is not set
CONFIG_NAND=y
CONFIG_NAND_ATMEL=y
CONFIG_PHYLIB=y
CONFIG_USB=y
CONFIG_DM_USB=y
CONFIG_USB_OHCI_HCD=y
CONFIG_USB_OHCI_GENERIC=y
CONFIG_USB_STORAGE=y
CONFIG_USB_GADGET=y
CONFIG_USB_GADGET_MANUFACTURER="Olimex Ltd."
CONFIG_USB_GADGET_VENDOR_NUM=0x15ba
CONFIG_USB_GADGET_PRODUCT_NUM=0x4321
CONFIG_USB_GADGET_DOWNLOAD=y
# CONFIG_EFI_LOADER is not set
CONFIG_WDT=y
CONFIG_WDT_AT91=y
CONFIG_AT91_HW_WDT_TIMEOUT=y
CONFIG_SPI_BOOT=y
CONFIG_CMD_MEMTEST=y
CONFIG_SYS_ALT_MEMTEST=y
CONFIG_CMD_BOOTZ=y
CONFIG_CMD_SF=y
CONFIG_CMD_SPI=y
CONFIG_CMD_MTD=y
CONFIG_SPI_FLASH=y
CONFIG_NET_RANDOM_ETHADDR=y
CONFIG_CMD_MII=y
CONFIG_SPI=y
CONFIG_DM_SPI=y
CONFIG_ATMEL_SPI=y
CONFIG_DM_SPI_FLASH=y
CONFIG_SPI_FLASH_ATMEL=y
CONFIG_SPI_FLASH_DATAFLASH=y
CONFIG_CONFIG_AT91_GPIO=y
CONFIG_PINCTRL=y
CONFIG_PINCTRL_AT91=y
CONFIG_DISTRO_DEFAULTS=y
```
